## arch/arm/mach-owl/Kconfig
```kconfig
menuconfig ARCH_OWL
	bool "Actions SoCs" if ARCH_MULTI_V7
	select GENERIC_IRQ_CHIP
	select ARCH_REQUIRE_GPIOLIB
	select PINCTRL
	select USE_OF
	select NEON
	select VFP
	select ARM_GIC
	select ARM_GLOBAL_TIMER
	select HAVE_ARM_ARCH_TIMER
	select HAVE_ARM_SCU if SMP
	select HAVE_ARM_TWD if SMP
	select HAVE_SMP
	select VIRT_TO_BUS
	select CACHE_L2X0
	select CLKSRC_MMIO
	select CLKDEV_LOOKUP
	select CLKSRC_ARM_GLOBAL_TIMER_SCHED_CLOCK
	select PINCTRL_OWL
	select GPIO_OWL
        help
	  Support for Actions Owl's Cortex-A9 Quad-Core-SoCs
	  containing the ATM7039, ATM7059 series.
```

## drivers/pinctrl/owl/Kconfig
```kconfig
if (ARCH_OWL)

config PINCTRL_OWL
	tristate "Actions Owl pin controller driver"
	depends on GPIOLIB && OF
	select PINMUX
	select PINCONF
	select GENERIC_PINCONF
	select GPIOLIB_IRQCHIP
	help
	  This is the pinctrl, pinmux, pinconf and gpiolib driver for the
	  Actions Owl Soc.
endif
```
