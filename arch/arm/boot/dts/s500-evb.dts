/*
 * Copyright (c) 2014 Actions Semiconductor Co., Ltd.
 *
 * Author: Yixun Lan <yixun.lan@gmail.com>
 *
 * This program is free software; you can redistribute it and/or modify
 * it under the terms of the GNU General Public License as published by
 * the Free Software Foundation; either version 2 of the License, or
 * (at your option) any later version.
 *
 * This program is distributed in the hope that it will be useful,
 * but WITHOUT ANY WARRANTY; without even the implied warranty of
 * MERCHANTABILITY or FITNESS FOR A PARTICULAR PURPOSE.  See the
 * GNU General Public License for more details.
 */

/dts-v1/;
#include "atm70xx.dtsi"

/ {
	compatible = "actions,atm7059";

	memory {
		reg = <0x00000000 0x40000000>;
	};

	serial@b0124000 {
		status = "okay";
	};
};
